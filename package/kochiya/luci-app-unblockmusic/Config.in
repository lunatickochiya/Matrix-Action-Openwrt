## package/kochiya/luci-app-unblockmusic/Config.in
```kconfig
config UnblockNeteaseMusic_Go
	bool "UnblockNeteaseMusic Golang Version"
	default y if i386||x86_64||arm||aarch64

config UnblockNeteaseMusic_NodeJS
	bool "UnblockNeteaseMusic NodeJS Version"
	default y if i386||x86_64||arm||aarch64
```
